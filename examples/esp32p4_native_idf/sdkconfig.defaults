## examples/esp32p4_native_idf/sdkconfig.defaults
```kconfig
# ESP32-P4 Configuration for M5Stack Tab5
CONFIG_IDF_TARGET_ESP32P4=y
CONFIG_IDF_TARGET="esp32p4"

# Flash and memory configuration
CONFIG_ESPTOOLPY_FLASHSIZE_16MB=y
CONFIG_ESPTOOLPY_FLASHFREQ_80M=y
CONFIG_ESPTOOLPY_FLASHMODE_QIO=y

# PSRAM Configuration (32MB on M5Stack Tab5)
CONFIG_ESP32P4_PSRAM_ENABLE=y
CONFIG_ESP32P4_PSRAM_SPEED_200M=y

# CPU Configuration
CONFIG_ESP32P4_CPU_FREQ_MHZ_400=y
CONFIG_ESP32P4_CPU_FREQ_MHZ=400

# Log configuration
CONFIG_LOG_DEFAULT_LEVEL_INFO=y
CONFIG_LOG_DEFAULT_LEVEL=3

# FreeRTOS Configuration
CONFIG_FREERTOS_HZ=1000

# Bootloader configuration
CONFIG_BOOTLOADER_LOG_LEVEL_INFO=y

# Compiler optimization
CONFIG_COMPILER_OPTIMIZATION_SIZE=y

# USB Serial/JTAG
CONFIG_ESP_CONSOLE_USB_SERIAL_JTAG=y

# Heap configuration for 32MB PSRAM
CONFIG_ESP32P4_INSTRUCTION_CACHE_16KB=y
CONFIG_ESP32P4_DATA_CACHE_64KB=y
```
